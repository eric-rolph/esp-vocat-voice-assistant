## firmware/echoear_brookesia/main/Kconfig.projbuild
```kconfig
menu "Example Configuration"
    menuconfig EXAMPLE_AGENTS_ENABLE_COZE
        bool "Enable Coze agent"
        select BROOKESIA_AGENT_COZE_ENABLE_AUTO_REGISTER
        default n

    if EXAMPLE_AGENTS_ENABLE_COZE
        config EXAMPLE_AGENTS_COZE_APP_ID
            string "App ID"
            default "110049xxxxxxx"

        config EXAMPLE_AGENTS_COZE_PUBLIC_KEY
            string "Public key"
            default "lsKjtB67xxxxxxxxxxxxxxxxxxxxxxxxxxxxxxxxxxx"

        config EXAMPLE_AGENTS_COZE_PRIVATE_KEY_FILE_PATH
            string "Private key"
            default "./private_key.pem"

        config EXAMPLE_AGENTS_COZE_CUSTOM_CONSUMER
            string "Custom consumer (Optional)"
            default ""

        menuconfig EXAMPLE_AGENTS_COZE_BOT1_ENABLE
            bool "Bot 1"
            default y

        if EXAMPLE_AGENTS_COZE_BOT1_ENABLE
            config EXAMPLE_AGENTS_COZE_BOT1_NAME
                string "Bot name"
                default "Lin Jia Nv Hai"

            config EXAMPLE_AGENTS_COZE_BOT1_ID
                string "Bot ID"
                default "7516538xxxxxxxxxxxx"

            config EXAMPLE_AGENTS_COZE_BOT1_DESCRIPTION
                string "Bot description"
                default "A warm-voiced female AI character who listens to the user's thoughts and offers comforting responses."

            config EXAMPLE_AGENTS_COZE_BOT1_VOICE_ID
                string "Bot voice ID"
                default "7426720361733144585"
        endif

        menuconfig EXAMPLE_AGENTS_COZE_BOT2_ENABLE
            bool "Bot 2"
            default n

        if EXAMPLE_AGENTS_COZE_BOT2_ENABLE
            config EXAMPLE_AGENTS_COZE_BOT2_NAME
                string "Bot name"
                default "Wan Qu Da Shu"

            config EXAMPLE_AGENTS_COZE_BOT2_ID
                string "Bot ID"
                default "7516538xxxxxxxxxxxx"

            config EXAMPLE_AGENTS_COZE_BOT2_DESCRIPTION
                string "Bot description"
                default "A male AI character with a regional accent. He responds quickly and concisely, but does not perform actions on behalf of the user."

            config EXAMPLE_AGENTS_COZE_BOT2_VOICE_ID
                string "Bot voice ID"
                default "7426720361732915209"
        endif
    endif

    menuconfig EXAMPLE_AGENTS_ENABLE_OPENAI
        bool "Enable OpenAI agent"
        select BROOKESIA_AGENT_OPENAI_ENABLE_AUTO_REGISTER
        default n

    if EXAMPLE_AGENTS_ENABLE_OPENAI
        config EXAMPLE_AGENTS_OPENAI_API_KEY
            string "API key"
            default "sk-proj-xxx"

        config EXAMPLE_AGENTS_OPENAI_MODEL
            string "Model"
            default "gpt-4o-realtime-preview"
    endif

    menuconfig EXAMPLE_AGENTS_ENABLE_XIAOZHI
        bool "Enable Xiaozhi agent"
        select BROOKESIA_AGENT_XIAOZHI_ENABLE_AUTO_REGISTER
        default y

    menuconfig EXAMPLE_AGENTS_ENABLE_REALTIME
        bool "Enable OpenAI Realtime agent (direct connection)"
        default y

    if EXAMPLE_AGENTS_ENABLE_REALTIME
        config EXAMPLE_AGENTS_REALTIME_API_KEY
            string "OpenAI API Key"
            default "sk-proj-xxx"
            help
                Your OpenAI API key for the Realtime API.

        config EXAMPLE_AGENTS_REALTIME_MODEL
            string "Realtime model"
            default "gpt-4o-realtime-preview"
            help
                The OpenAI Realtime model to use (e.g. gpt-4o-realtime-preview).

        config EXAMPLE_AGENTS_REALTIME_VOICE
            string "Voice"
            default "alloy"
            help
                Voice for TTS output (alloy, echo, fable, onyx, nova, shimmer).

        config EXAMPLE_AGENTS_REALTIME_SYSTEM_PROMPT
            string "System prompt"
            default "You are a helpful assistant on a small IoT device. Keep responses concise."
            help
                System prompt / instructions for the assistant.
    endif
endmenu
```

## firmware/echoear_brookesia/sdkconfig.defaults.esp32s3
```kconfig
CONFIG_SR_WN_WN9_HIESP=y
CONFIG_SPIRAM=y
CONFIG_SPIRAM_MODE_OCT=y
CONFIG_SPIRAM_SPEED_80M=y
CONFIG_SPIRAM_FETCH_INSTRUCTIONS=y
CONFIG_SPIRAM_RODATA=y
```
